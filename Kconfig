## Kconfig
```kconfig
# Copyright (c) 2025 Crab Labs LLC
# SPDX-License-Identifier: MIT

menuconfig MAX3010X
	bool "MAX3010x pulse oximeter and heart rate sensor"
	default y
	depends on DT_HAS_MAXIM_MAX3010X_ENABLED
	select I2C
	select GPIO
	select SENSOR
	help
	  Enable the MAX3010x driver (MAX30101/MAX30102).
	  These defaults are applied at init. Use runtime API to change settings.

if MAX3010X

config MAX3010X_INIT_PRIORITY
	int "MAX3010x initialization priority"
	default 90
	help
	  Device initialization priority for MAX3010x.
	  Should be higher than I2C bus priority.

config MAX3010X_LOG_LEVEL
	int "MAX3010x log level"
	default 2
	range 0 4
	help
	  Sets log level for MAX3010x driver.
	  0 = OFF, 1 = ERR, 2 = WRN, 3 = INF, 4 = DBG

# Operating Mode

choice MAX3010X_MODE
	prompt "Operating mode"
	default MAX3010X_MODE_MULTI_LED
	help
	  Select the default operating mode.
	  Multi-LED mode is recommended for full control over which LEDs are active.

config MAX3010X_MODE_HEART_RATE
	bool "Heart rate mode (Red LED only)"

config MAX3010X_MODE_SPO2
	bool "SpO2 mode (Red + IR)"

config MAX3010X_MODE_MULTI_LED
	bool "Multi-LED mode (configurable slots)"

endchoice

# Sample Rate and ADC

config MAX3010X_SAMPLE_RATE
	int "Sample rate (0-7)"
	range 0 7
	default 1
	help
	  Sample rate selection:
	    0 = 50 Hz
	    1 = 100 Hz (default)
	    2 = 200 Hz
	    3 = 400 Hz
	    4 = 800 Hz
	    5 = 1000 Hz
	    6 = 1600 Hz
	    7 = 3200 Hz

config MAX3010X_PULSE_WIDTH
	int "LED pulse width (0-3)"
	range 0 3
	default 3
	help
	  LED pulse width selection (affects ADC resolution):
	    0 = 69us (15-bit ADC)
	    1 = 118us (16-bit ADC)
	    2 = 215us (17-bit ADC, low-power application default)
	    3 = 411us (18-bit ADC, maximum resolution)

config MAX3010X_ADC_RANGE
	int "ADC full-scale range (0-3)"
	range 0 3
	default 2
	help
	  ADC range selection (higher = more headroom, less sensitivity):
	    0 = 7.81 pA/LSB (2048 nA full scale)
	    1 = 15.63 pA/LSB (4096 nA full scale)
	    2 = 31.25 pA/LSB (8192 nA full scale, default)
	    3 = 62.5 pA/LSB (16384 nA full scale)

# FIFO Configuration

config MAX3010X_SAMPLE_AVG
	int "Sample averaging (0-7)"
	range 0 7
	default 0
	help
	  Number of samples to average before storing in FIFO:
	    0 = 1 sample (no averaging, default)
	    1 = 2 samples
	    2 = 4 samples
	    3 = 8 samples
	    4 = 16 samples
	    5-7 = 32 samples

config MAX3010X_FIFO_ROLLOVER_EN
	bool "FIFO rollover enable"
	default y
	help
	  When enabled, FIFO overwrites oldest data when full.
	  When disabled, FIFO stops accepting new data when full.

config MAX3010X_FIFO_A_FULL
	int "FIFO almost-full threshold (0-15)"
	range 0 15
	default 8
	help
	  Number of empty FIFO slots when almost-full interrupt triggers.
	  FIFO depth is 32 samples, so 8 means interrupt at 24 samples.

# LED Currents
# 0x00 = 0mA, 0xFF = 51mA (0.2mA per LSB)
# Default: ~10mA for Red/IR, ~6mA for Green (lower power for neonatal)

config MAX3010X_LED1_PA
	hex "LED1 (Red) pulse amplitude"
	range 0 0xff
	default 0x32
	help
	  Red LED current: 0x00=0mA to 0xFF=51mA (0.2mA/LSB).
	  Default 0x32 = 10mA, suitable for neonatal skin.

config MAX3010X_LED2_PA
	hex "LED2 (IR) pulse amplitude"
	range 0 0xff
	default 0x32
	help
	  IR LED current: 0x00=0mA to 0xFF=51mA (0.2mA/LSB).
	  Default 0x32 = 10mA.

config MAX3010X_LED3_PA
	hex "LED3 (Green) pulse amplitude"
	range 0 0xff
	default 0x1E
	help
	  Green LED current: 0x00=0mA to 0xFF=51mA (0.2mA/LSB).
	  Default 0x1E = 6mA. Only used on MAX30101.

config MAX3010X_LED4_PA
	hex "LED4 (second green current sink) pulse amplitude"
	range 0 0xff
	default 0x1E
	help
	  Second current sink for the same green LED (MAX30101 only).
	  Default 0x1E matches LED3 at 6mA.

config MAX3010X_PILOT_PA
	hex "Pilot LED pulse amplitude"
	range 0 0xff
	default 0x00
	help
	  Pilot LED current for proximity detection.
	  Default 0x00 = disabled.

# Multi-LED Slot Configuration
# Slot values: 0=disabled, 1=RED, 2=IR, 3=GREEN (MAX30101 only)

config MAX3010X_SLOT1
	int "Slot 1 LED selection (0-3)"
	range 0 3
	default 1
	help
	  First time slot LED:
	    0 = Disabled
	    1 = Red (LED1_PA)
	    2 = IR (LED2_PA)
	    3 = Green (MAX30101 only, LED3_PA + LED4_PA)

	  Enabled slots must be contiguous from slot 1.

config MAX3010X_SLOT2
	int "Slot 2 LED selection (0-3)"
	range 0 3
	default 2
	help
	  Second time slot LED. Default: IR.

config MAX3010X_SLOT3
	int "Slot 3 LED selection (0-3)"
	range 0 3
	default 0
	help
	  Third time slot LED. Green is available only on MAX30101.

config MAX3010X_SLOT4
	int "Slot 4 LED selection (0-3)"
	range 0 3
	default 0
	help
	  Fourth time slot LED. Default: Disabled.

# Interrupts (runtime configuration recommended)

config MAX3010X_INT_ENABLE_1
	hex "Interrupt enable 1 mask"
	range 0 0xff
	default 0x00
	help
	  Interrupt enable register 1 default value.
	  Usually configured at runtime via max3010x_set_interrupts().
	  Bit 7: FIFO almost full
	  Bit 6: New data ready
	  Bit 5: Ambient light overflow
	  Bit 4: Proximity interrupt

config MAX3010X_INT_ENABLE_2
	hex "Interrupt enable 2 mask"
	range 0 0xff
	default 0x00
	help
	  Interrupt enable register 2 default value.
	  Bit 1: Die temperature ready

config MAX3010X_PROX_INT_THRESH
	hex "Proximity interrupt threshold"
	range 0 0xff
	default 0x00
	help
	  Proximity detection threshold (0x00 = disabled).

config MAX3010X_TEMP_ENABLE
	bool "Enable die temperature at init"
	default n
	help
	  Start temperature conversion at init. Usually not needed.

# IRQ Configuration

config MAX3010X_IRQ_ENABLE
	bool "Enable interrupt GPIO support"
	default y
	help
	  Enable support for the INT pin interrupt functionality.
	  When disabled, the driver will not configure or use the INT GPIO
	  even if specified in devicetree. Use polling mode instead.
	  Disable this if the INT pin is not connected or not needed.

endif # MAX3010X
```

## dts/bindings/sensor/maxim,max3010x.yaml
```yaml
# Copyright (c) 2025 Makani Science
# SPDX-License-Identifier: Apache-2.0

description: |
  Maxim MAX3010x pulse oximeter and heart rate sensor.

  Supports MAX30101 (Red + IR + Green LEDs) and MAX30102 (Red + IR LEDs).
  Used for PPG (photoplethysmography) measurements in SpO2 and heart rate
  monitoring applications.

  The driver initializes the device in shutdown mode. Call max3010x_enable()
  to start measurements. Configuration defaults come from Kconfig and can
  be changed at runtime via the driver API.

  Example devicetree node:
    &i2c0 {
      ppg: max30101@57 {
        compatible = "maxim,max3010x";
        reg = <0x57>;
        variant = "max30101";
        int-gpios = <&gpio0 12 (GPIO_ACTIVE_LOW | GPIO_PULL_UP)>;
      };
    };

compatible: "maxim,max3010x"

include: [sensor-device.yaml, i2c-device.yaml]

properties:
  variant:
    type: string
    required: true
    enum:
      - "max30101"
      - "max30102"
    description: |
      Silicon variant on the board.
        - max30101: 3 LEDs (Red, IR, Green) - full SpO2 + PPG
        - max30102: 2 LEDs (Red, IR) - SpO2 only

  int-gpios:
    type: phandle-array
    description: |
      Optional interrupt GPIO connected to the sensor INT pin.
      The MAX3010x INT pin is open-drain, active-low.

      When configured, the driver can trigger callbacks on:
        - FIFO almost full (for batch reads)
        - New PPG data ready
        - Ambient light overflow
        - Proximity detection
        - Die temperature ready

      If not specified, polling mode must be used.
```
